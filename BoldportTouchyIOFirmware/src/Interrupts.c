//=========================================================
// src/Interrupts.c: generated by Hardware Configurator
//
// This file will be regenerated when saving a document.
// leave the sections inside the "$[...]" comment tags alone
// or they will be overwritten!
//=========================================================

// USER INCLUDES
#include <SI_EFM8SB1_Register_Enums.h>
#include "touchy.h"
#include "main.h"

//-----------------------------------------------------------------------------
// UART0_ISR
//-----------------------------------------------------------------------------
//
// UART0 ISR Content goes here. Remember to clear flag bits:
// SCON0::RI (Receive Interrupt Flag)
// SCON0::TI (Transmit Interrupt Flag)
//
//-----------------------------------------------------------------------------
SI_INTERRUPT (UART0_ISR, UART0_IRQn)
{
	static uint8_t rxByteNumber = 0, txByteNumber = 0, newByte = 0;

#ifdef ACTIVITY_LED
	TouchyLEDOn(ACTIVITY_LED);
#endif

	if (SCON0_RI == 1) {
		if (rxByteNumber < UART_BUFFERSIZE) {
			newByte = SBUF0;	// get the byte we just received

			SCON0_RI = 0;		// clear interrupt flag since we have the data now

			rxBuffer[rxByteNumber] = newByte;	// write the received byte into the buffer

			rxByteNumber++;				// increment our counter

			rxBufferReady = false;		// buffer is not ready/complete at this point, unless...

			if (rxByteNumber >= UART_BUFFERSIZE) {
				rxByteNumber = 0;		// ...reset it if it maxed out

				if (rxBuffer[0] & SOF) {
					rxBufferReady = true;	// if SOF is valid, indicate that the buffer is now valid
				}
				else {
					flags |= RXERROR;		// indicate a receive error probably occurred
				}

				if (rxBuffer[0] & TXERROR) {
					flags |= TXERROR;		// set flag if the host indicated an error
				}
			}
		}
		else {						// we should never end up here. just a safety thing...
			rxByteNumber = 0;
		}
	}

	if (SCON0_TI == 1) {			// check if transmit flag is set
		SCON0_TI = 0;				// clear interrupt flag

		if (txByteNumber < UART_BUFFERSIZE) {	// if there are more bytes to transmit...
			SBUF0 = txBuffer[txByteNumber];		// send the next byte

			txByteNumber++;			// update counter
		}
		else {
			txByteNumber = 0;		// Reset the counter

			txReady = true;			// Indicate transmission complete
		}
	}

#ifdef ACTIVITY_LED
	TouchyLEDOff(ACTIVITY_LED);
#endif
}
